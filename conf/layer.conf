## conf/layer.conf
```bitbake
# We have a conf and classes directory, add to BBPATH
BBPATH .= ":${LAYERDIR}"

# We have recipes-* directories, add to BBFILES
BBFILES += "${LAYERDIR}/recipes-*/*/*.bb \
            ${LAYERDIR}/recipes-*/*/*.bbappend"

BBFILE_COLLECTIONS += "mender-const-conf"
BBFILE_PATTERN_mender-const-conf = "^${LAYERDIR}/"

INHERIT += "mender-const-conf-vars"

LAYERDEPENDS_mender-const-conf = "core                         \
                                  mender                       \
                                  bitbake-variable-substitution"

LAYERSERIES_COMPAT_mender-const-conf = "kirkstone mickledore nanbield"
```
